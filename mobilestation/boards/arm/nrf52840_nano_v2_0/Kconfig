## mobilestation/boards/arm/nrf52840_nano_v2_0/Kconfig
```kconfig
# nRF52840 DK NRF52840 board configuration

# Copyright (c) 2016 Nordic Semiconductor ASA
# SPDX-License-Identifier: Apache-2.0

if BOARD_NRF52840_NANO_V2_0

config BOARD_ENABLE_DCDC
	bool "DCDC mode"
	select SOC_DCDC_NRF52X
	default n

config BOARD_ENABLE_DCDC_HV
	bool "High Voltage DCDC converter"
	select SOC_DCDC_NRF52X_HV
	default n

endif # BOARD_NRF52840_NANO_V2_0
```

## mobilestation/boards/arm/nrf52840_nano_v2_0/Kconfig.board
```kconfig
# nRF52840 DK NRF52840 board configuration

# Copyright (c) 2016 Nordic Semiconductor ASA
# SPDX-License-Identifier: Apache-2.0

config BOARD_NRF52840_NANO_V2_0
	bool "NRF52840 NANO_V2_0"
	depends on SOC_NRF52840_QIAA
```

## mobilestation/boards/arm/nrf52840_nano_v2_0/Kconfig.defconfig
```kconfig
# nRF52840 DK NRF52840 board configuration

# Copyright (c) 2016 Nordic Semiconductor ASA
# SPDX-License-Identifier: Apache-2.0

if BOARD_NRF52840_NANO_V2_0

config BOARD
	default "nrf52840_nano_v2_0"

config BT_CTLR
	default BT

endif # BOARD_NRF52840_NANO_V2_0
```
